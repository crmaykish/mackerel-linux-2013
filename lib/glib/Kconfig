## lib/glib/Kconfig
```kconfig
config LIB_GLIB
	bool 'glib'
	help
	  glib library

config LIB_GLIB_STATIC
	bool 'build static'
	depends on LIB_GLIB
	help
	  Build static version of glib (and similar libs)

config LIB_GLIB_TOOLS
	bool 'tools'
	depends on LIB_GLIB
	help
	  glib command line tools
```
